## conf/bblayers.conf
```bitbake
# POKY_BBLAYERS_CONF_VERSION is increased each time build/conf/bblayers.conf
# changes incompatibly
POKY_BBLAYERS_CONF_VERSION = "2"

BBPATH = "${TOPDIR}"
BBFILES ?= ""

BBLAYERS ?= " \
  /pruebasyocto/poky/meta \
  /pruebasyocto/poky/meta-poky \
  /pruebasyocto/poky/meta-yocto-bsp \
  /pruebasyocto/meta-raspberrypi \
  /pruebasyocto/poky/meta-tensorflow-lite \
  /pruebasyocto/meta-python \
  /pruebasyocto/meta-oe \
  /pruebasyocto/poky/build/meta-progra \
  "
```

## confazure/conf/bblayers.conf
```bitbake
# POKY_BBLAYERS_CONF_VERSION is increased each time build/conf/bblayers.conf
# changes incompatibly
POKY_BBLAYERS_CONF_VERSION = "2"

BBPATH = "${TOPDIR}"
BBFILES ?= ""

BBLAYERS ?= " \
  /datadrive/poky/meta \
  /datadrive/poky/meta-poky \
  /datadrive/poky/meta-yocto-bsp \
  /datadrive/poky/meta-raspberrypi \
  /datadrive/poky/meta-openembedded/meta-python \
  /datadrive/poky/meta-openembedded/meta-oe \
  /datadrive/poky/meta-tensorflow-lite \
  "
```
